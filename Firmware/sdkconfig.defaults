## Firmware/sdkconfig.defaults
```kconfig
CONFIG_MODEL_IN_SPIFFS=y
CONFIG_USE_AFE=n
CONFIG_USE_WAKENET=y
CONFIG_USE_MULTINET=n
CONFIG_SR_WN_WN9_HILEXIN=n
CONFIG_SR_WN_WN9_HIESP=y
CONFIG_SR_WN_LOAD_MULIT_WORD=n
CONFIG_ARDUINO_VARIANT="esp32s3"
CONFIG_AUTOSTART_ARDUINO=y
CONFIG_FREERTOS_HZ=1000
CONFIG_PARTITION_TABLE_CUSTOM=y
CONFIG_PARTITION_TABLE_CUSTOM_FILENAME="partitions.csv"
CONFIG_ESPTOOLPY_FLASHSIZE_16MB=y
CONFIG_ESPTOOLPY_FLASHSIZE_DETECT=n
CONFIG_ESPTOOLPY_FLASHMODE_QIO=y
CONFIG_ESPTOOLPY_FLASHFREQ_80M=y
CONFIG_ESP32S3_SPIRAM_SUPPORT=y
CONFIG_SPIRAM_MODE_OCT=y
CONFIG_SPIRAM_TYPE_ESPPSRAM64=y
CONFIG_SPIRAM_SPEED_80M=y
CONFIG_SPIRAM_USE_MALLOC=y
```
